VERSION ""

NS_ :

BS_:

BU_:

BO_ 2 MSG_2: 8 Vector__XXX
 SG_ Counter_002 : 16|8@1+ (1,0) [0|255] "" Vector__XXX

BO_ 112 MSG_70: 8 Vector__XXX
 SG_ Counter_070 : 48|4@1+ (1,0) [0|15] "" Vector__XXX
 SG_ Checksum_070 : 56|8@1+ (1,0) [0|255] "" Vector__XXX

BO_ 117 MSG_75: 8 Vector__XXX
 SG_ Counter_075 : 48|4@1+ (1,0) [0|15] "" Vector__XXX
 SG_ Checksum_075 : 56|8@1+ (1,0) [0|255] "" Vector__XXX

BO_ 1040 MSG_410: 8 Vector__XXX

BO_ 1041 MSG_411: 8 Vector__XXX
 SG_ BrakeSwitch_411 : 52|1@1+ (1,0) [0|1] "" Vector__XXX

BO_ 1042 MSG_412: 8 Vector__XXX

BO_ 1056 MSG_420: 8 Vector__XXX
 SG_ GearState_420 : 8|8@1+ (1,0) [0|255] "" Vector__XXX

BO_ 1057 MSG_421: 8 Vector__XXX
 SG_ Counter_421 : 24|8@1+ (1,0) [0|255] "" Vector__XXX

BO_ 1058 MSG_422: 8 Vector__XXX
 SG_ GearSelector_422 : 16|8@1+ (1,0) [0|255] "" Vector__XXX

BO_ 1281 MSG_501: 8 Vector__XXX
 SG_ Counter_501 : 40|8@1+ (1,0) [0|255] "" Vector__XXX

BO_ 1297 MSG_511: 8 Vector__XXX
 SG_ BrakePressure_511 : 32|8@1+ (1,0) [0|255] "raw" Vector__XXX

BO_ 1298 MSG_512: 8 Vector__XXX
 SG_ BrakeSwitch_512 : 36|1@1+ (1,0) [0|1] "" Vector__XXX
 SG_ Counter_512 : 40|8@1+ (1,0) [0|255] "" Vector__XXX

BO_ 1299 MSG_513: 8 Vector__XXX

BO_ 1300 MSG_514: 8 Vector__XXX
 SG_ BrakeSwitch_514 : 3|1@1+ (1,0) [0|1] "" Vector__XXX
 SG_ Counter_514 : 48|4@1+ (1,0) [0|15] "" Vector__XXX

BO_ 1398 MSG_576: 8 Vector__XXX
 SG_ Counter_576 : 48|4@1+ (1,0) [0|15] "" Vector__XXX
 SG_ Checksum_576 : 56|8@1+ (1,0) [0|255] "" Vector__XXX

BO_ 1536 MSG_600: 8 Vector__XXX
 SG_ Counter_600 : 32|8@1+ (1,0) [0|255] "" Vector__XXX

BO_ 1537 MSG_601: 8 Vector__XXX

BO_ 1568 MSG_620: 8 Vector__XXX
 SG_ GearSelector_620 : 16|8@1+ (1,0) [0|255] "" Vector__XXX

CM_ "2012 Subaru Forester (SH, FB25, auto), CAN traffic at the OBD port, 500 kbit/s. Worked out by watching captures (logs/can_*.csv, probe.py --listen) while doing known things; not official Subaru definitions. Import in the website under Tools > CAN bus > Signals, keep identifying, export and save back over this file.";
CM_ BO_ 2 "Steering angle on a 2016 WRX (bytes 0-1, afreiday/2016-wrx-can-ids); unconfirmed here - didn't move in the 26 Nov capture (no steering).";
CM_ BO_ 112 "Values sitting just either side of 0x8000 with sensor-like noise in bytes 0-1 and 4-5 while parked: possibly yaw rate or acceleration. Unconfirmed.";
CM_ BO_ 1040 "Engine group candidate: bytes 0 and 2 rose, bytes 5-6 (16-bit, little-endian) fell, with a rev and with the engine loading up in Drive. Which is throttle, load or torque: to confirm with probe.py --listen --with-ssm.";
CM_ BO_ 1042 "Engine group candidate: bytes 1-2 (16-bit, little-endian; bytes 3-4 repeat them) rose from about 440 at idle to 684 with a rev / Drive. To confirm against logged engine speed and load.";
CM_ BO_ 1299 "All zeros while parked: would fit wheel speeds. Check on a slow drive.";
CM_ BO_ 1536 "Bytes 3 and 7 each rose by exactly one over 10 s (86->87, 84->85): slow, like temperatures. Check against coolant and intake air temperature.";
CM_ BO_ 1537 "Engine group candidate: byte 3 rose from about 74 at idle to 106 with a rev / Drive.";
CM_ SG_ 2 Counter_002 "Steps every frame (both halves of the byte): a message counter.";
CM_ SG_ 112 Counter_070 "4-bit rolling counter, +1 every frame.";
CM_ SG_ 112 Checksum_070 "Changes unpredictably right after the counter: likely a checksum.";
CM_ SG_ 117 Counter_075 "4-bit rolling counter, +1 every frame.";
CM_ SG_ 117 Checksum_075 "Changes unpredictably right after the counter: likely a checksum.";
CM_ SG_ 1041 BrakeSwitch_411 "Byte 6 bit 4. Confirmed 26 Nov: on 3.4 s, off 4.4 s, on 5.1 s, as the brake was pressed, released and held.";
CM_ SG_ 1056 GearState_420 "Byte 1: 0x88 in Park, 0x77 in Drive (0 for a moment while shifting). Confirmed 26 Nov, P > D > P.";
CM_ SG_ 1057 Counter_421 "8-bit rolling counter, +1 every frame.";
CM_ SG_ 1058 GearSelector_422 "Byte 2: 7 in Park, 6 in Drive, 8 for a moment passing R/N. Confirmed 26 Nov, P > D > P. R and N not yet seen on their own.";
CM_ SG_ 1281 Counter_501 "8-bit rolling counter, +1 every frame.";
CM_ SG_ 1297 BrakePressure_511 "Byte 4: 0 released, rising to about 49 held firmly, easing off on release. Likely brake pressure; real units unknown (raw).";
CM_ SG_ 1298 BrakeSwitch_512 "Byte 4 bit 4. Confirmed 26 Nov: on 3.41 s, off 4.41 s, on 5.03 s with the brake.";
CM_ SG_ 1298 Counter_512 "8-bit rolling counter, +1 every frame.";
CM_ SG_ 1300 BrakeSwitch_514 "Byte 0 bit 3. Confirmed 26 Nov: on 3.43 s, off 4.43 s, on 5.05 s with the brake.";
CM_ SG_ 1300 Counter_514 "4-bit counter in the low half of byte 6, steps by 2.";
CM_ SG_ 1398 Counter_576 "4-bit rolling counter, +1 every frame.";
CM_ SG_ 1398 Checksum_576 "Changes unpredictably right after the counter: likely a checksum.";
CM_ SG_ 1536 Counter_600 "8-bit rolling counter, +1 every frame.";
CM_ SG_ 1568 GearSelector_620 "Byte 2: 7 in Park, 3 in Drive. Confirmed 26 Nov, P > D > P.";
VAL_ 1056 GearState_420 136 "P" 119 "D" ;
VAL_ 1058 GearSelector_422 7 "P" 6 "D" 8 "passing R/N" ;
VAL_ 1568 GearSelector_620 7 "P" 3 "D" ;
